## Documentation/devicetree/bindings/clock/brcm,brcmstb-cpu-clk-div.txt
```
The CPU divider node serves as the sole clock for the CPU complex. It supports
power-of-2 clock division, with a divider of "1" as the default highest-speed
setting.

Required properties:
- compatible: shall be "brcm,brcmstb-cpu-clk-div"
- reg: address and width of the divider configuration register
- #clock-cells: shall be set to 0
- clocks: phandle of clock provider which provides the source clock
          (this would typically be a "fixed-clock" type PLL)
- div-table: list of (raw_value,divider) ordered pairs that correspond to the
             allowed clock divider settings
- div-shift-width: least-significant bit position and width of divider value

Optional properties:
- clock-names: the clock may be named

Example:
	cpuclkdiv: cpu-clk-div@f03e257c {
		compatible = "brcm,brcmstb-cpu-clk-div";
		reg = <0xf03e257c 0x4>;
		div-table = <0x00 1>;
		div-shift-width = <0 5>;
		#clock-cells = <0>;
		clocks = <&cpupll>;
		clock-names = "cpupll";
	};
```
